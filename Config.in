## package/uhd/Config.in
```kconfig
comment "uhd needs a toolchain w/ C++, NPTL, wchar, dynamic library"
	depends on BR2_USE_MMU
	depends on !BR2_INSTALL_LIBSTDCPP || !BR2_USE_WCHAR || \
		!BR2_TOOLCHAIN_HAS_THREADS_NPTL || BR2_STATIC_LIBS

config BR2_PACKAGE_UHD
	bool "uhd"
	depends on BR2_INSTALL_LIBSTDCPP
	depends on !BR2_STATIC_LIBS
	depends on BR2_TOOLCHAIN_HAS_THREADS_NPTL
	depends on BR2_USE_MMU # use fork()
	depends on BR2_USE_WCHAR # boost
	select BR2_PACKAGE_BOOST
	select BR2_PACKAGE_BOOST_CHRONO
	select BR2_PACKAGE_BOOST_DATE_TIME
	select BR2_PACKAGE_BOOST_FILESYSTEM
	select BR2_PACKAGE_BOOST_PROGRAM_OPTIONS
	select BR2_PACKAGE_BOOST_REGEX
	select BR2_PACKAGE_BOOST_SERIALIZATION
	select BR2_PACKAGE_BOOST_SYSTEM
	select BR2_PACKAGE_BOOST_THREAD
	select BR2_PACKAGE_BOOST_ATOMIC
	help
	  Universal Software Radio Peripheral (USRP) Hardware Driver

	  https://kb.etthus.com

if BR2_PACKAGE_UHD

config BR2_PACKAGE_UHD_B100
	bool "b100 support"
	select BR2_PACKAGE_UHD_USB
	help
	  enable B100 support

config BR2_PACKAGE_UHD_B200
	bool "b200 support"
	select BR2_PACKAGE_UHD_USB
	help
	  enable B200 support

config BR2_PACKAGE_UHD_E300
	bool "E300 support"
	select BR2_PACKAGE_UHD_MPMD
	help
	  enable E300 support

config BR2_PACKAGE_UHD_E320
	bool "E320 support"
	select BR2_PACKAGE_UHD_MPMD
	help
	  enable E320 support

config BR2_PACKAGE_UHD_EXAMPLES
	bool "uhd-examples"
	help
	  Examples

config BR2_PACKAGE_UHD_MPMD
	bool "MPMD support"
	help
	  enable MPMD support

config BR2_PACKAGE_UHD_N230
	bool "N230 support"
	help
	  enable N230 support

config BR2_PACKAGE_UHD_N300
	bool "N300 support"
	select BR2_PACKAGE_UHD_MPMD
	help
	  enable N300 support

config BR2_PACKAGE_UHD_N320
	bool "N320 support"
	select BR2_PACKAGE_UHD_MPMD
	help
	  enable N320 support

config BR2_PACKAGE_UHD_OCTOCLOCK
	bool "OctoClock support"
	help
	  enable OctoClock support

comment "uhd python API needs python(3) and a toolchain w/ glibc or musl"
	depends on !(BR2_PACKAGE_PYTHON && BR2_PACKAGE_PYTHON3)
	depends on !BR2_PACKAGE_PYTHON_NUMPY_ARCH_SUPPORTS
	depends on !(BR2_TOOLCHAIN_USES_GLIBC && BR2_TOOLCHAIN_USES_MUSL) # python-numpy

config BR2_PACKAGE_UHD_PYTHON
	bool "python API support"
	depends on BR2_PACKAGE_PYTHON || BR2_PACKAGE_PYTHON3
	depends on BR2_PACKAGE_PYTHON_NUMPY_ARCH_SUPPORTS
	depends on BR2_TOOLCHAIN_USES_GLIBC || BR2_TOOLCHAIN_USES_MUSL # python-numpy
	select BR2_PACKAGE_PYTHON_NUMPY
	select BR2_PACKAGE_PYTHON_REQUESTS
	help
	  enable python API support

config BR2_PACKAGE_UHD_RFNOC
	bool "uhd-rfnoc"
	select BR2_PACKAGE_RFNOC
	help
	  RFNoC support

config BR2_PACKAGE_UHD_USB
	bool "uhd-USB"
	select BR2_PACKAGE_LIBUSB
	help
	  USB support

config BR2_PACKAGE_UHD_USRP1
	bool "USRP1 support"
	select BR2_PACKAGE_UHD_USB
	help
	  enable USRP1 support

config BR2_PACKAGE_UHD_USRP2
	bool "USRP2 support"
	help
	  enable USRP2 support

comment "uhd utils depends on python API support"
	depends on !BR2_PACKAGE_UHD_PYTHON

config BR2_PACKAGE_UHD_UTILS
	bool "uhd-utils"
	depends on BR2_PACKAGE_UHD_PYTHON
	select BR2_PACKAGE_PYTHON_SIX
	help
	  uhd-utils

config BR2_PACKAGE_UHD_X300
	bool "X300 support"
	help
	  enable X300 support

endif
```

## package/vxi11/Config.in
```kconfig
config BR2_PACKAGE_VXI11
	bool "vxi11"
	depends on BR2_TOOLCHAIN_HAS_THREADS # libtirpc
	select BR2_PACKAGE_LIBTIRPC
	help
	  RPC protocol for communicating with VXI11-enabled devices over
	  ehternet from Linux (including instruments such as oscillos

	  http://optics.eee.nottingham.ac.uk/vxi11/

comment "vxi11 needs a toolchain w/ threads"
	depends on !BR2_TOOLCHAIN_HAS_THREADS
```

## package/xtrx_linux_pcie_drv/Config.in
```kconfig
# Prompt-less option, because this package is not doing anything
# except downloading the xtrx linux pcie drv sources. The real
# work is done by a Linux extension.
config BR2_PACKAGE_XTRX_LINUX_PCIE_DRV
	bool
	depends on BR2_LINUX_KERNEL
	help
	  XTRX PCI driver for linux

	  https://github.com/xtrx-sdr/xtrx_linux_pcie_drv
```
