## Config.in
```kconfig
source "$BR2_EXTERNAL_PLUTOSDR_PATH/linux/Config.ext.in"
source "$BR2_EXTERNAL_PLUTOSDR_PATH/package/ad936x_ref_cal/Config.in"
source "$BR2_EXTERNAL_PLUTOSDR_PATH/package/gnss-sdr/Config.in"
source "$BR2_EXTERNAL_PLUTOSDR_PATH/package/libad9361-iio/Config.in"
source "$BR2_EXTERNAL_PLUTOSDR_PATH/package/libiio-pluto/Config.in"
source "$BR2_EXTERNAL_PLUTOSDR_PATH/package/libini/Config.in"
source "$BR2_EXTERNAL_PLUTOSDR_PATH/package/liblms7002m/Config.in"
source "$BR2_EXTERNAL_PLUTOSDR_PATH/package/libusb3380/Config.in"
source "$BR2_EXTERNAL_PLUTOSDR_PATH/package/libxtrx/Config.in"
source "$BR2_EXTERNAL_PLUTOSDR_PATH/package/libxtrxll/Config.in"
source "$BR2_EXTERNAL_PLUTOSDR_PATH/package/libxtrxdsp/Config.in"
source "$BR2_EXTERNAL_PLUTOSDR_PATH/package/pluto-system-top-bit/Config.in"
source "$BR2_EXTERNAL_PLUTOSDR_PATH/package/poll_sysfs/Config.in"
source "$BR2_EXTERNAL_PLUTOSDR_PATH/package/uhd-pluto/Config.in"
source "$BR2_EXTERNAL_PLUTOSDR_PATH/package/gr-iio/Config.in"
source "$BR2_EXTERNAL_PLUTOSDR_PATH/package/vxi11/Config.in"
source "$BR2_EXTERNAL_PLUTOSDR_PATH/package/librpitx/Config.in"
source "$BR2_EXTERNAL_PLUTOSDR_PATH/package/rpitx/Config.in"
source "$BR2_EXTERNAL_PLUTOSDR_PATH/package/ft8_lib/Config.in"
source "$BR2_EXTERNAL_PLUTOSDR_PATH/package/xtrx_linux_pcie_drv/Config.in"
```

## configs/raspberrypi3_64_gnuradio_defconfig
```kconfig
BR2_aarch64=y
BR2_ARM_FPU_VFPV4=y
BR2_JLEVEL=1
BR2_TOOLCHAIN_BUILDROOT_GLIBC=y
BR2_PACKAGE_HOST_LINUX_HEADERS_CUSTOM_5_4=y
BR2_TOOLCHAIN_BUILDROOT_CXX=y
BR2_ROOTFS_DEVICE_CREATION_DYNAMIC_EUDEV=y
BR2_SYSTEM_DHCP="eth0"
BR2_ROOTFS_POST_BUILD_SCRIPT="board/raspberrypi3-64/post-build.sh"
BR2_ROOTFS_POST_IMAGE_SCRIPT="board/raspberrypi3-64/post-image.sh"
BR2_ROOTFS_POST_SCRIPT_ARGS="--aarch64 --add-miniuart-bt-overlay"
BR2_LINUX_KERNEL=y
BR2_LINUX_KERNEL_CUSTOM_TARBALL=y
BR2_LINUX_KERNEL_CUSTOM_TARBALL_LOCATION="$(call github,raspberrypi,linux,1c64f4bc22811d2d371b271daa3fb27895a8abdd)/linux-1c64f4bc22811d2d371b271daa3fb27895a8abdd.tar.gz"
BR2_LINUX_KERNEL_DEFCONFIG="bcmrpi3"
BR2_LINUX_KERNEL_DTS_SUPPORT=y
BR2_LINUX_KERNEL_INTREE_DTS_NAME="broadcom/bcm2710-rpi-3-b broadcom/bcm2710-rpi-3-b-plus broadcom/bcm2837-rpi-3-b"
BR2_LINUX_KERNEL_NEEDS_HOST_OPENSSL=y
BR2_PACKAGE_LIBERATION=y
BR2_PACKAGE_QT5=y
BR2_PACKAGE_RPI_FIRMWARE=y
BR2_PACKAGE_PYTHON3=y
# BR2_PACKAGE_LIBRTLSDR_ZEROCOPY is not set
BR2_PACKAGE_GNURADIO=y
BR2_PACKAGE_GNURADIO_PYTHON=y
BR2_PACKAGE_GNURADIO_ZEROMQ=y
BR2_PACKAGE_GNURADIO_ANALOG=y
BR2_PACKAGE_GNURADIO_QTGUI=y
BR2_PACKAGE_GR_OSMOSDR=y
BR2_PACKAGE_GR_OSMOSDR_PYTHON=y
BR2_PACKAGE_GR_OSMOSDR_RTLSDR=y
BR2_TARGET_ROOTFS_EXT2=y
BR2_TARGET_ROOTFS_EXT2_4=y
BR2_TARGET_ROOTFS_EXT2_SIZE="512M"
# BR2_TARGET_ROOTFS_TAR is not set
BR2_PACKAGE_HOST_DOSFSTOOLS=y
BR2_PACKAGE_HOST_GENIMAGE=y
BR2_PACKAGE_HOST_MTOOLS=y
```

## configs/raspberrypi4_64_gnuradio_defconfig
```kconfig
BR2_aarch64=y
BR2_cortex_a72=y
BR2_ARM_FPU_VFPV4=y
BR2_JLEVEL=1
BR2_TOOLCHAIN_BUILDROOT_GLIBC=y
BR2_PACKAGE_HOST_LINUX_HEADERS_CUSTOM_5_4=y
BR2_TOOLCHAIN_BUILDROOT_CXX=y
BR2_TOOLCHAIN_BUILDROOT_FORTRAN=y
BR2_ROOTFS_DEVICE_CREATION_DYNAMIC_EUDEV=y
BR2_SYSTEM_DHCP="eth0"
BR2_LINUX_KERNEL=y
BR2_LINUX_KERNEL_CUSTOM_TARBALL=y
BR2_LINUX_KERNEL_CUSTOM_TARBALL_LOCATION="$(call github,raspberrypi,linux,1c64f4bc22811d2d371b271daa3fb27895a8abdd)/linux-1c64f4bc22811d2d371b271daa3fb27895a8abdd.tar.gz"
BR2_LINUX_KERNEL_DEFCONFIG="bcm2711"
BR2_LINUX_KERNEL_DTS_SUPPORT=y
BR2_LINUX_KERNEL_INTREE_DTS_NAME="broadcom/bcm2711-rpi-4-b"
BR2_LINUX_KERNEL_NEEDS_HOST_OPENSSL=y
BR2_PACKAGE_LIBERATION=y
BR2_PACKAGE_QT5=y
BR2_PACKAGE_RPI_FIRMWARE=y
BR2_PACKAGE_RPI_FIRMWARE_VARIANT_PI4=y
BR2_PACKAGE_RPI_FIRMWARE_DEFAULT=y
BR2_PACKAGE_RPI_FIRMWARE_BOOT="4"
BR2_PACKAGE_PYTHON3=y
# BR2_PACKAGE_LIBRTLSDR_ZEROCOPY is not set
BR2_PACKAGE_ARMADILLO=y
BR2_PACKAGE_OPENBLAS=y
BR2_PACKAGE_GNURADIO=y
BR2_PACKAGE_GNURADIO_PYTHON=y
BR2_PACKAGE_GNURADIO_ZEROMQ=y
BR2_PACKAGE_GNURADIO_QTGUI=y
BR2_PACKAGE_GR_OSMOSDR=y
BR2_PACKAGE_GR_OSMOSDR_PYTHON=y
BR2_PACKAGE_GR_OSMOSDR_RTLSDR=y
BR2_PACKAGE_DROPBEAR=y
BR2_TARGET_ROOTFS_EXT2=y
BR2_TARGET_ROOTFS_EXT2_4=y
BR2_TARGET_ROOTFS_EXT2_SIZE="512M"
# BR2_TARGET_ROOTFS_TAR is not set
BR2_PACKAGE_HOST_DOSFSTOOLS=y
BR2_PACKAGE_HOST_GENIMAGE=y
BR2_PACKAGE_HOST_MTOOLS=y
BR2_PACKAGE_GNSS_SDR=y
BR2_PACKAGE_GNSS_SDR_UHD=y
BR2_PACKAGE_UHD=y
BR2_PACKAGE_UHD_B200=y
BR2_PACKAGE_VXI11=y
BR2_ROOTFS_POST_BUILD_SCRIPT="board/raspberrypi4-64/post-build.sh"
BR2_ROOTFS_POST_IMAGE_SCRIPT="board/raspberrypi4-64/post-image.sh"
BR2_ROOTFS_POST_SCRIPT_ARGS="--add-miniuart-bt-overlay --aarch64"
```

## configs/zynq_pluto_defconfig
```kconfig
BR2_arm=y
BR2_cortex_a9=y
BR2_ARM_ENABLE_NEON=y
BR2_ARM_ENABLE_VFP=y
BR2_CCACHE=y
BR2_GLOBAL_PATCH_DIR="${BR2_EXTERNAL_PLUTOSDR_PATH}/board/pluto/patches"
BR2_TOOLCHAIN_BUILDROOT_GLIBC=y
BR2_KERNEL_HEADERS_4_9=y
BR2_TOOLCHAIN_BUILDROOT_CXX=y
BR2_TARGET_GENERIC_HOSTNAME="pluto"
BR2_TARGET_GENERIC_ISSUE="Welcome to Pluto - oscimp"
BR2_ROOTFS_DEVICE_CREATION_DYNAMIC_MDEV=y
BR2_TARGET_GENERIC_ROOT_PASSWD="root"
BR2_TARGET_GENERIC_GETTY_PORT="ttyPS0"
BR2_ROOTFS_OVERLAY="${BR2_EXTERNAL_PLUTOSDR_PATH}/board/pluto/overlay"
BR2_ROOTFS_POST_BUILD_SCRIPT="${BR2_EXTERNAL_PLUTOSDR_PATH}/board/pluto/post-build.sh"
BR2_ROOTFS_POST_IMAGE_SCRIPT="${BR2_EXTERNAL_PLUTOSDR_PATH}/board/pluto/post_image.sh ${BR2_EXTERNAL_PLUTOSDR_PATH}/board/pluto/post_image-uboot.sh"
BR2_LINUX_KERNEL=y
BR2_LINUX_KERNEL_CUSTOM_GIT=y
BR2_LINUX_KERNEL_CUSTOM_REPO_URL="https://github.com/analogdevicesinc/linux.git"
BR2_LINUX_KERNEL_CUSTOM_REPO_VERSION="387d584d434e723476c3807e3c087684999e1bb0"
BR2_LINUX_KERNEL_DEFCONFIG="zynq_pluto"
BR2_LINUX_KERNEL_CONFIG_FRAGMENT_FILES="$(BR2_EXTERNAL_PLUTOSDR_PATH)/board/pluto/linux-$(BR2_LINUX_KERNEL_VERSION).fragment"
BR2_LINUX_KERNEL_DTS_SUPPORT=y
BR2_LINUX_KERNEL_INTREE_DTS_NAME="zynq-pluto-sdr-revc zynq-pluto-sdr-revb zynq-pluto-sdr"
BR2_LINUX_KERNEL_DTB_OVERLAY_SUPPORT=y
BR2_PACKAGE_BUSYBOX_CONFIG="${BR2_EXTERNAL_PLUTOSDR_PATH}/board/pluto/busybox-1.25.0.config"
BR2_PACKAGE_STRACE=y
BR2_PACKAGE_MTD=y
# BR2_PACKAGE_MTD_NANDDUMP is not set
# BR2_PACKAGE_MTD_NANDTEST is not set
# BR2_PACKAGE_MTD_NANDWRITE is not set
# BR2_PACKAGE_MTD_UBIATTACH is not set
# BR2_PACKAGE_MTD_UBICRC32 is not set
# BR2_PACKAGE_MTD_UBIDETACH is not set
# BR2_PACKAGE_MTD_UBIFORMAT is not set
# BR2_PACKAGE_MTD_UBIMKVOL is not set
# BR2_PACKAGE_MTD_UBINFO is not set
# BR2_PACKAGE_MTD_UBINIZE is not set
# BR2_PACKAGE_MTD_UBIRENAME is not set
# BR2_PACKAGE_MTD_UBIRMVOL is not set
# BR2_PACKAGE_MTD_UBIRSVOL is not set
# BR2_PACKAGE_MTD_UBIUPDATEVOL is not set
# BR2_PACKAGE_MTD_UBIBLOCK is not set
BR2_PACKAGE_NFS_UTILS=y
BR2_PACKAGE_NFS_UTILS_RPC_LOCKD=y
BR2_PACKAGE_INPUT_EVENT_DAEMON=y
BR2_PACKAGE_UBOOT_TOOLS=y
BR2_PACKAGE_PYTHON3=y
BR2_PACKAGE_PYTHON_CRYPTOGRAPHY=y
BR2_PACKAGE_PYTHON_IPYTHON=y
BR2_PACKAGE_PYTHON_LXML=y
BR2_PACKAGE_PYTHON_PYZMQ=y
BR2_PACKAGE_PYTHON_REMI=y
BR2_PACKAGE_LIBNL=y
BR2_PACKAGE_FFTW_FAST=y
BR2_PACKAGE_GSL=y
BR2_PACKAGE_LIBDAEMON=y
BR2_PACKAGE_DROPBEAR=y
# BR2_PACKAGE_DROPBEAR_CLIENT is not set
BR2_PACKAGE_IPTABLES=y
BR2_PACKAGE_SCREEN=y
BR2_PACKAGE_HTOP=y
BR2_TARGET_ROOTFS_CPIO=y
BR2_TARGET_ROOTFS_CPIO_GZIP=y
BR2_TARGET_ROOTFS_CPIO_UIMAGE=y
BR2_TARGET_UBOOT=y
BR2_TARGET_UBOOT_BUILD_SYSTEM_KCONFIG=y
BR2_TARGET_UBOOT_CUSTOM_GIT=y
BR2_TARGET_UBOOT_CUSTOM_REPO_URL="https://github.com/analogdevicesinc/u-boot-xlnx.git"
BR2_TARGET_UBOOT_CUSTOM_REPO_VERSION="89d07540f9d489cc63460df5636174357af0a38f"
BR2_TARGET_UBOOT_BOARD_DEFCONFIG="zynq_pluto"
BR2_TARGET_UBOOT_NEEDS_DTC=y
BR2_TARGET_UBOOT_NEEDS_OPENSSL=y
# BR2_TARGET_UBOOT_FORMAT_BIN is not set
BR2_TARGET_UBOOT_FORMAT_IMG=y
BR2_TARGET_UBOOT_SPL=y
BR2_TARGET_UBOOT_SPL_NAME="spl/boot.bin"
BR2_PACKAGE_HOST_DFU_UTIL=y
BR2_PACKAGE_HOST_DOSFSTOOLS=y
BR2_PACKAGE_HOST_GENIMAGE=y
BR2_PACKAGE_HOST_MTOOLS=y
BR2_PACKAGE_HOST_UBOOT_TOOLS_FIT_SUPPORT=y
BR2_PACKAGE_HOST_UBOOT_TOOLS_FIT_SIGNATURE_SUPPORT=y
BR2_PACKAGE_HOST_UBOOT_TOOLS_ENVIMAGE=y
BR2_PACKAGE_HOST_UBOOT_TOOLS_ENVIMAGE_SOURCE="${BR2_EXTERNAL_PLUTOSDR_PATH}/board/pluto/uboot-env.txt"
BR2_PACKAGE_HOST_UBOOT_TOOLS_ENVIMAGE_SIZE="0x20000"
BR2_PACKAGE_AD936X_REF_CAL=y
BR2_PACKAGE_LIBAD9361_IIO=y
BR2_PACKAGE_LIBIIO_PLUTO_IIOD_USBD=y
BR2_PACKAGE_LIBIIO_PLUTO_TESTS=y
BR2_PACKAGE_LIBIIO_PLUTO_BINDINGS_PYTHON=y
BR2_PACKAGE_LIBINI=y
BR2_PACKAGE_PLUTO_SYSTEM_TOP_BIT=y
BR2_PACKAGE_POLL_SYSFS=y
```

## package/ad936x_ref_cal/Config.in
```kconfig
config BR2_PACKAGE_AD936X_REF_CAL
	bool "Reference clock calibration utility for AD9361/3/4"
	depends on BR2_TOOLCHAIN_HAS_THREADS
	select BR2_PACKAGE_FFTW
	select BR2_PACKAGE_FFTW_DOUBLE
	select BR2_PACKAGE_LIBIIO_PLUTO
	help
	  Reference clock calibration utility for AD9361/3/4
```

## package/ft8_lib/Config.in
```kconfig
config BR2_PACKAGE_FT8_LIB
	bool "ft8_lib"
	help
	  FT8 automated radiofrequency beacon library
```

## package/gnss-sdr/Config.in
```kconfig
comment "gnss-sdr needs a toolchain w/ C++, fortran, NPTL, wchar, dynamic library"
	depends on BR2_USE_MMU
	depends on !BR2_INSTALL_LIBSTDCPP || !BR2_USE_WCHAR || \
		!BR2_TOOLCHAIN_HAS_THREADS_NPTL || BR2_STATIC_LIBS
comment "gnss-sdr needs python3, gnuradio and armadillo"
	depends on !(BR2_PACKAGE_PYTHON3 && BR2_PACKAGE_GNURADIO && BR2_PACKAGE_ARMADILLO)
comment "gnss-sdr can't work with clapack"
	depends on BR2_PACKAGE_CLAPACK

config BR2_PACKAGE_GNSS_SDR
	bool "gnss-sdr"
	depends on BR2_INSTALL_LIBSTDCPP
	depends on !BR2_STATIC_LIBS
	depends on BR2_TOOLCHAIN_HAS_THREADS_NPTL
	depends on BR2_TOOLCHAIN_USES_GLIBC # clapack
	depends on BR2_USE_WCHAR # gnutls
	depends on BR2_PACKAGE_ARMADILLO
	depends on BR2_PACKAGE_GNURADIO
	depends on BR2_PACKAGE_PROTOBUF_ARCH_SUPPORTS # protobuf
	depends on BR2_PACKAGE_PYTHON3
	select BR2_PACKAGE_BOOST_FILESYSTEM
	select BR2_PACKAGE_BOOST_SERIALIZATION
	select BR2_PACKAGE_GFLAGS
	select BR2_PACKAGE_GLOG
	select BR2_PACKAGE_GNURADIO_ANALOG
	select BR2_PACKAGE_GNURADIO_BLOCKS
	select BR2_PACKAGE_GNURADIO_FFT
	select BR2_PACKAGE_GNURADIO_FILTER
	select BR2_PACKAGE_GNUTLS
	select BR2_PACKAGE_GNUTLS_OPENSSL
	select BR2_PACKAGE_LAPACK
	select BR2_PACKAGE_LOG4CPP
	select BR2_PACKAGE_MATIO
	select BR2_PACKAGE_OPENSSL
	select BR2_PACKAGE_PROTOBUF
	select BR2_PACKAGE_PUGIXML

	help
	  GNU Radio block for interfacing with various radio hardware

	  http://osmocom.org/projects/osmosdr

if BR2_PACKAGE_GNSS_SDR

config BR2_PACKAGE_GNSS_SDR_AD9361
	bool "enable AD9361 support"
	select BR2_PACKAGE_LIBIIO_PLUTO
	help
	  Enable the use of AD9361

config BR2_PACKAGE_GNSS_SDR_OSMOSDR
	bool "enable osmosdr support"
	select BR2_PACKAGE_GR_OSMOSDR
	help
	  Enable the use of OsmoSDR

comment "UHD support for gnss-sdr needs gnuradio with uhd"
	depends on !BR2_PACKAGE_GNURADIO_UHD

config BR2_PACKAGE_GNSS_SDR_UHD
	bool "enable UHD support"
	depends on BR2_PACKAGE_GNURADIO_UHD
	help
	  Enable the use of UHD

comment "PlutoSDR support for gnss-sdr needs gr-iio"
	depends on !BR2_PACKAGE_GR_IIO

config BR2_PACKAGE_GNSS_SDR_PLUTOSDR
	bool "enable PlutoSDR support"
	depends on BR2_PACKAGE_GR_IIO
	help
	  Enable the use of PlutoSDR
endif
```

## package/gr-iio/Config.in
```kconfig
comment "gr-iio needs gnuradio w/ python support"
	depends on !BR2_PACKAGE_GNURADIO_PYTHON

config BR2_PACKAGE_GR_IIO
	bool "gr-iio"
	depends on BR2_PACKAGE_GNURADIO
	depends on BR2_PACKAGE_GNURADIO_PYTHON
	select BR2_PACKAGE_LIBAD9361_IIO
	select BR2_PACKAGE_GNURADIO_ANALOG
	select BR2_PACKAGE_GNURADIO_BLOCKS
	select BR2_PACKAGE_GNURADIO_FFT
	select BR2_PACKAGE_GNURADIO_FILTER
	help
	  GNU Radio IIO Blocks
	  https://github.com/analogdevicesinc/gr-iio
```

## package/libft8/Config.in
```kconfig
config BR2_PACKAGE_LIBFT8
	bool "libft8"
	help
	  FT8 automated radiofrequency beacon library
```

## package/liblms7002m/Config.in
```kconfig
config BR2_PACKAGE_LIBLMS7002M
	bool "liblms7002m"
	depends on BR2_PACKAGE_PYTHON3
	select BR2_PACKAGE_PYTHON3_CHEETAH
	help
	  Compact LMS7002 library suitable for MCU

	  https://github.com/xtrx-sdr/liblms7002m
```

## package/libusb3380/Config.in
```kconfig
config BR2_PACKAGE_LIBUSB3380
	bool "libusb3380"
	depends on BR2_PACKAGE_PYTHON3
	select BR2_PACKAGE_PYTHON3_CHEETAH
	help
	  Compact LMS7002 library suitable for MCU

	  https://github.com/xtrx-sdr/libusb3380
```

## package/libxtrx/Config.in
```kconfig
config BR2_PACKAGE_LIBXTRX
	bool "libxtrx"
	depends on BR2_PACKAGE_LIBLMS7002M
	select BR2_PACKAGE_LIBXTRXLL
	select BR2_PACKAGE_LIBXTRXDSP
	help
	  High level XTRX API

	  https://github.com/xtrx-sdr/libxtrx
```

## package/libxtrxdsp/Config.in
```kconfig
config BR2_PACKAGE_LIBXTRXDSP
	bool "libxtrxdsp"
	help
	  DSP specific function for SDR in general and XTRX in specific

	  https://github.com/xtrx-sdr/libxtrxdsp
```

## package/libxtrxll/Config.in
```kconfig
config BR2_PACKAGE_LIBXTRXLL
	bool "libxtrxll"
	help
	  Low level XTRX hardware abstraction library

	  https://github.com/xtrx-sdr/libxtrxll
```

## package/matio/Config.in
```kconfig
config BR2_PACKAGE_MATIO
	bool "matio"
	select BR2_PACKAGE_ZLIB
	help
	  matio is an C library for reading and writing MATLAB MAT
	  files.
	  https://sourceforge.net/projects/matio

if BR2_PACKAGE_MATIO

config BR2_PACKAGE_MATIO_SPARSE
	bool "sparse support"

endif
```

## package/rpitx/Config.in
```kconfig
config BR2_PACKAGE_RPITX
	bool "rpitx"
	select BR2_PACKAGE_FT8_LIB
	select BR2_PACKAGE_LIBRPITX
	select BR2_PACKAGE_LIBSNDFILE
	help
	  RPiTX application
```
